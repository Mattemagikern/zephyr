## CMakeLists.txt
```
# SPDX-License-Identifier: Apache-2.0

cmake_minimum_required(VERSION 3.28.0)
find_package(Zephyr REQUIRED HINTS $ENV{ZEPHYR_BASE})
project(ringbuffer)


target_sources(app PRIVATE
    src/main.c
    src/concurrent.c
  )

target_sources_ifndef(CONFIG_RING_BUFFER
    app PRIVATE
    src/index_math.c
  )

target_sources_ifdef(CONFIG_RING_BUFFER
    app PRIVATE
    src/deprecated.c
  )

target_sources_ifdef(CONFIG_ZTEST_BENCHMARK
  app PRIVATE
  src/benchmark.c
)
```

## prj.conf
```kconfig
CONFIG_ZTEST=y
CONFIG_ZTRESS=y
CONFIG_ZTEST_BENCHMARK=y
CONFIG_TEST_EXTRA_STACK_SIZE=1024
CONFIG_IRQ_OFFLOAD=y
CONFIG_TEST_RANDOM_GENERATOR=y
CONFIG_ENTROPY_GENERATOR=y
CONFIG_XOSHIRO_RANDOM_GENERATOR=y
CONFIG_MP_MAX_NUM_CPUS=1

CONFIG_ASSERT=n
```

## src/benchmark.c
```c
#include <string.h>
#include <zephyr/ztest.h>
#include <zephyr/sys/ring_buffer.h>

#define BENCH_BUF_SIZE 128
#define BENCH_OP_SIZE  16

static uint8_t bench_storage[BENCH_BUF_SIZE];
static struct ring_buf bench_rb;
static uint8_t bench_payload[BENCH_OP_SIZE];
static uint8_t *bench_ptr;

static void suite_setup(void)
{
	ring_buf_init(&bench_rb, BENCH_BUF_SIZE, bench_storage);
}

ZTEST_BENCHMARK_SUITE(ring_buffer, suite_setup, NULL);

static void setup_empty(void)
{
	ring_buf_reset(&bench_rb);
}

static void setup_full(void)
{
	ring_buf_reset(&bench_rb);
	ring_buf_put(&bench_rb, bench_payload, BENCH_OP_SIZE);
}

static void setup_pending_put_ptr(void)
{
	setup_empty();
	ring_buf_put_ptr(&bench_rb, &bench_ptr, 0);
}

#ifdef CONFIG_RING_BUFFER
static void setup_pending_put_claim(void)
{
	setup_empty();
	ring_buf_put_claim(&bench_rb, &bench_ptr, BENCH_OP_SIZE);
}
#endif

static void setup_pending_get_ptr(void)
{
	setup_full();
	ring_buf_get_ptr(&bench_rb, &bench_ptr, 0);
}

#ifdef CONFIG_RING_BUFFER
static void setup_pending_get_claim(void)
{
	setup_full();
	ring_buf_get_claim(&bench_rb, &bench_ptr, BENCH_OP_SIZE);
}
#endif

static void advance_heads(uint32_t bytes)
{
	while (bytes) {
		uint32_t step = MIN(bytes, BENCH_OP_SIZE);

		ring_buf_put(&bench_rb, bench_payload, step);
		ring_buf_get(&bench_rb, bench_payload, step);
		bytes -= step;
	}
}

static void setup_pre_wrap_empty(void)
{
	setup_empty();
	advance_heads(BENCH_BUF_SIZE - BENCH_OP_SIZE / 2);
}

static void setup_pre_wrap_full(void)
{
	setup_pre_wrap_empty();
	ring_buf_put(&bench_rb, bench_payload, BENCH_OP_SIZE);
}

ZTEST_BENCHMARK(ring_buffer, put, 100, setup_empty, NULL)
{
	ring_buf_put(&bench_rb, bench_payload, BENCH_OP_SIZE);
}

ZTEST_BENCHMARK(ring_buffer, get, 100, setup_full, NULL)
{
	ring_buf_get(&bench_rb, bench_payload, BENCH_OP_SIZE);
}

ZTEST_BENCHMARK(ring_buffer, put_ptr, 100, setup_empty, NULL)
{
	ring_buf_put_ptr(&bench_rb, &bench_ptr, 0);
}

ZTEST_BENCHMARK(ring_buffer, commit, 100, setup_pending_put_ptr, NULL)
{
	ring_buf_commit(&bench_rb, BENCH_OP_SIZE);
}

ZTEST_BENCHMARK(ring_buffer, get_ptr, 100, setup_full, NULL)
{
	ring_buf_get_ptr(&bench_rb, &bench_ptr, 0);
}

ZTEST_BENCHMARK(ring_buffer, consume, 100, setup_pending_get_ptr, NULL)
{
	ring_buf_consume(&bench_rb, BENCH_OP_SIZE);
}

#ifdef CONFIG_RING_BUFFER
ZTEST_BENCHMARK(ring_buffer, put_claim, 100, setup_empty, NULL)
{
	ring_buf_put_claim(&bench_rb, &bench_ptr, BENCH_OP_SIZE);
}

ZTEST_BENCHMARK(ring_buffer, put_finish, 100, setup_pending_put_claim, NULL)
{
	ring_buf_put_finish(&bench_rb, BENCH_OP_SIZE);
}

ZTEST_BENCHMARK(ring_buffer, put_claim_copy_finish, 100, setup_empty, NULL)
{
	uint8_t *p;

	ring_buf_put_claim(&bench_rb, &p, BENCH_OP_SIZE);
	memcpy(p, bench_payload, BENCH_OP_SIZE);
	ring_buf_put_finish(&bench_rb, BENCH_OP_SIZE);
}

ZTEST_BENCHMARK(ring_buffer, get_claim, 100, setup_full, NULL)
{
	ring_buf_get_claim(&bench_rb, &bench_ptr, BENCH_OP_SIZE);
}

ZTEST_BENCHMARK(ring_buffer, get_finish, 100, setup_pending_get_claim, NULL)
{
	ring_buf_get_finish(&bench_rb, BENCH_OP_SIZE);
}

ZTEST_BENCHMARK(ring_buffer, get_claim_copy_finish, 100, setup_full, NULL)
{
	uint8_t out[BENCH_OP_SIZE];
	uint8_t *p;

	ring_buf_get_claim(&bench_rb, &p, BENCH_OP_SIZE);
	memcpy(out, p, BENCH_OP_SIZE);
	ring_buf_get_finish(&bench_rb, BENCH_OP_SIZE);
}
#endif

ZTEST_BENCHMARK(ring_buffer, put_ptr_commit_wrap, 100, setup_pre_wrap_empty, NULL)
{
	uint8_t *p;
	uint32_t off = 0;

	while (off < BENCH_OP_SIZE) {
		uint32_t n = MIN(ring_buf_put_ptr(&bench_rb, &p, off), BENCH_OP_SIZE - off);

		memcpy(p, bench_payload + off, n);
		off += n;
	}
	ring_buf_commit(&bench_rb, off);
}

ZTEST_BENCHMARK(ring_buffer, get_ptr_consume_wrap, 100, setup_pre_wrap_full, NULL)
{
	uint8_t out[BENCH_OP_SIZE];
	uint8_t *p;
	uint32_t off = 0;

	while (off < BENCH_OP_SIZE) {
		uint32_t n = MIN(ring_buf_get_ptr(&bench_rb, &p, off), BENCH_OP_SIZE - off);

		memcpy(out + off, p, n);
		off += n;
	}
	ring_buf_consume(&bench_rb, off);
}

#ifdef CONFIG_RING_BUFFER
ZTEST_BENCHMARK(ring_buffer, put_claim_copy_finish_wrap, 100,
			       setup_pre_wrap_empty, NULL)
{
	uint8_t *p;
	uint32_t off = 0;

	while (off < BENCH_OP_SIZE) {
		uint32_t n = ring_buf_put_claim(&bench_rb, &p, BENCH_OP_SIZE - off);

		memcpy(p, &bench_payload[off], n);
		ring_buf_put_finish(&bench_rb, n);
		off += n;
	}
}

ZTEST_BENCHMARK(ring_buffer, get_claim_copy_finish_wrap, 100,
			       setup_pre_wrap_full, NULL)
{
	uint8_t out[BENCH_OP_SIZE];
	uint8_t *p;
	uint32_t off = 0;

	while (off < BENCH_OP_SIZE) {
		uint32_t n = ring_buf_get_claim(&bench_rb, &p, BENCH_OP_SIZE - off);

		memcpy(&out[off], p, n);
		ring_buf_get_finish(&bench_rb, n);
		off += n;
	}
}
#endif
```
