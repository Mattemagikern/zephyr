## CMakeLists.txt
```
# Copyright (c) 2025 Måns Ansgariusson <mansgariusson@gmail.com>
# SPDX-License-Identifier: Apache-2.0

cmake_minimum_required(VERSION 3.20.0)
find_package(Zephyr REQUIRED HINTS $ENV{ZEPHYR_BASE})
project(memref)

target_sources(app PRIVATE
  src/sys_heap.c
  src/mempool.c
  src/memslab.c
)
```

## prj.conf
```kconfig
CONFIG_ZTEST=y
CONFIG_MEMREF=y
CONFIG_MEMREF_VALIDATION=y

CONFIG_HEAP_MEM_POOL_SIZE=1024
```

## src/mempool.c
```c
/*
 * Copyright (c) 2025, Måns Ansgariusson <mansgariusson@gmail.com>
 *
 * SPDX-License-Identifier: Apache-2.0
 */
#include <zephyr/ztest.h>
#include <zephyr/sys/memref.h>

#include <zephyr/logging/log.h>
LOG_MODULE_REGISTER(memref_mempool, LOG_LEVEL_DBG);
ZTEST_SUITE(memref_mempool, NULL, NULL, NULL, NULL, NULL);

K_HEAP_DEFINE(mempool, 4096);

void *k_heap_alloc_wrapper(void *ctx, size_t size)
{
	return k_heap_alloc((struct k_heap *)ctx, size, K_NO_WAIT);
}

void k_heap_free_wrapper(void *ctx, void *mem)
{
	k_heap_free((struct k_heap *)ctx, mem);
}

MEMREF_BACKEND(mempool_backend, k_heap_alloc_wrapper, k_heap_free_wrapper, &mempool);

struct container {
	struct k_sem *sem;
};

static void container_cleanup(void *ptr)
{
	struct container *mem = ptr;

	k_sem_give(mem->sem);
}

ZTEST(memref_mempool, basic)
{
	void *mem;

	mem = memref_alloc(&mempool_backend, sizeof(mem), NULL);
	zassert_not_null(mem, "memref_alloc failed");
	memref_unref(&mempool_backend, mem);
}
ZTEST(memref_mempool, cleanup_called)
{
	struct container *mem;
	struct k_sem sem;

	k_sem_init(&sem, 0, 1);

	mem = memref_alloc(&mempool_backend, sizeof(mem), container_cleanup);
	zassert_not_null(mem, "memref_alloc failed");
	mem->sem = &sem;
	memref_unref(&mempool_backend, mem);
	zassert_ok(k_sem_take(&sem, K_MSEC(100)), "cleanup not called");
}

ZTEST(memref_mempool, multi_owners)
{
	struct container *mem;
	struct k_sem sem;

	k_sem_init(&sem, 0, 1);

	mem = memref_alloc(&mempool_backend, sizeof(mem), container_cleanup);
	zassert_not_null(mem, "memref_alloc failed");
	mem->sem = &sem;
	memref_ref(&mempool_backend, mem);
	memref_unref(&mempool_backend, mem);
	zassert_ok(!k_sem_take(&sem, K_MSEC(100)), "cleanup called when refcount > 0");
	memref_unref(&mempool_backend, mem);
	zassert_ok(k_sem_take(&sem, K_MSEC(100)), "cleanup not called");
}

ZTEST(memref_mempool, calloc_zeroed)
{
	uint8_t *mem;

	mem = memref_calloc(&mempool_backend, 8, 12, NULL);
	zassert_not_null(mem, "memref_alloc failed");
	for (size_t i = 0; i < 8*12; i++) {
		zassert_equal(mem[i], 0, "[%d] mem not zeroed", i);
	}
	memref_unref(&mempool_backend, mem);
}

ZTEST(memref_mempool, stress_allocs)
{
	void *mem;
	const size_t alloc_size = 64;
	const size_t iterations = 100;

	for (size_t i = 0; i < iterations; i++) {
		mem = memref_alloc(&mempool_backend, alloc_size, NULL);
		zassert_not_null(mem, "memref_alloc failed");
		memref_unref(&mempool_backend, mem);
	}
}
```

## src/memslab.c
```c
/*
 * Copyright (c) 2025, Måns Ansgariusson <mansgariusson@gmail.com>
 *
 * SPDX-License-Identifier: Apache-2.0
 */
#include <zephyr/kernel.h>

#include <zephyr/logging/log.h>
LOG_MODULE_REGISTER(memref_memslab, LOG_LEVEL_DBG);

#include "memref_testcases.h"

K_MEM_SLAB_DEFINE(memslab, 128, 10, 4);

void *memslab_alloc_wrapper(void *ctx, size_t size)
{
	void *mem;

	(void)size;

	if (k_mem_slab_alloc(ctx, &mem, K_NO_WAIT) != 0) {
		return NULL;
	}

	return mem;
}

void memslab_free_wrapper(void *ctx, void *mem)
{
	k_mem_slab_free(ctx, mem);
}

MEMREF_BACKEND_DEFINE(memslab_backend, memslab_alloc_wrapper, memslab_free_wrapper, &memslab);

MEMREF_TESTCASES(memref_memslab, &memslab_backend);
```

## src/sys_heap.c
```c
/*
 * Copyright (c) 2025, Måns Ansgariusson <mansgariusson@gmail.com>
 *
 * SPDX-License-Identifier: Apache-2.0
 */
#include <zephyr/ztest.h>
#include <zephyr/sys/memref.h>

#include <zephyr/logging/log.h>
LOG_MODULE_REGISTER(memref_sys_heap, LOG_LEVEL_DBG);
ZTEST_SUITE(memref_sys_heap, NULL, NULL, NULL, NULL, NULL);

void *k_malloc_wrapper(void *ctx, size_t size)
{
	(void)ctx;

	return k_malloc(size);
}

void k_free_wrapper(void *ctx, void *mem)
{
	(void)ctx;

	k_free(mem);
}

MEMREF_BACKEND(sys_heap, k_malloc_wrapper, k_free_wrapper, NULL);

struct container {
	struct k_sem *sem;
};

static void container_cleanup(void *ptr)
{
	struct container *mem = ptr;

	k_sem_give(mem->sem);
}

ZTEST(memref_sys_heap, basic)
{
	void *mem;

	mem = memref_alloc(&sys_heap, sizeof(mem), NULL);
	zassert_not_null(mem, "memref_alloc failed");
	memref_unref(&sys_heap, mem);
}
ZTEST(memref_sys_heap, cleanup_called)
{
	struct container *mem;
	struct k_sem sem;

	k_sem_init(&sem, 0, 1);

	mem = memref_alloc(&sys_heap, sizeof(mem), container_cleanup);
	zassert_not_null(mem, "memref_alloc failed");
	mem->sem = &sem;
	memref_unref(&sys_heap, mem);
	zassert_ok(k_sem_take(&sem, K_MSEC(100)), "cleanup not called");
}

ZTEST(memref_sys_heap, multi_owners)
{
	struct container *mem;
	struct k_sem sem;

	k_sem_init(&sem, 0, 1);

	mem = memref_alloc(&sys_heap, sizeof(mem), container_cleanup);
	zassert_not_null(mem, "memref_alloc failed");
	mem->sem = &sem;
	memref_ref(&sys_heap, mem);
	memref_unref(&sys_heap, mem);
	zassert_ok(!k_sem_take(&sem, K_MSEC(100)), "cleanup called when refcount > 0");
	memref_unref(&sys_heap, mem);
	zassert_ok(k_sem_take(&sem, K_MSEC(100)), "cleanup not called");
}

ZTEST(memref_sys_heap, calloc_zeroed)
{
	uint8_t *mem;

	mem = memref_calloc(&sys_heap, 8, 12, NULL);
	zassert_not_null(mem, "memref_alloc failed");
	LOG_DBG("mem allocated at %p", mem);
	for (size_t i = 0; i < 8*12; i++) {
		zassert_equal(mem[i], 0, "[%d] mem not zeroed", i);
	}
	memref_unref(&sys_heap, mem);
}

ZTEST(memref_sys_heap, stress_allocs)
{
	void *mem;
	const size_t alloc_size = 64;
	const size_t iterations = 100;

	for (size_t i = 0; i < iterations; i++) {
		mem = memref_alloc(&sys_heap, alloc_size, NULL);
		zassert_not_null(mem, "memref_alloc failed");
		memref_unref(&sys_heap, mem);
	}
}
```

## src/test_cases.c
```c
/*
 * Copyright (c) 2025 Måns Ansgariusson <mansgariusson@gmail.com>
 *
 * SPDX-License-Identifier: Apache-2.0
 */

#include <zephyr/kernel.h>

#include "memref_testcases.h"

struct container {
	struct k_sem *sem;
};

static void container_cleanup(void *ptr)
{
	struct container *mem = ptr;

	k_sem_give(mem->sem);
}

void memref_test_basic(const struct memref_backend *be)
{
	void *mem;

	mem = memref_alloc(be, sizeof(mem), NULL);
	zassert_not_null(mem, "memref_alloc failed");
	memref_unref(mem);
}

void memref_test_cleanup_called(const struct memref_backend *be)
{
	struct container *mem;
	struct k_sem sem;

	k_sem_init(&sem, 0, 1);

	mem = memref_alloc(be, sizeof(mem), container_cleanup);
	zassert_not_null(mem, "memref_alloc failed");
	mem->sem = &sem;
	memref_unref(mem);
	zassert_ok(k_sem_take(&sem, K_MSEC(100)), "cleanup not called");
}

void memref_test_multi_owners(const struct memref_backend *be)
{
	struct container *mem;
	struct k_sem sem;

	k_sem_init(&sem, 0, 1);

	mem = memref_alloc(be, sizeof(mem), container_cleanup);
	zassert_not_null(mem, "memref_alloc failed");
	mem->sem = &sem;
	memref_ref(mem);
	memref_unref(mem);
	zassert_not_equal(k_sem_take(&sem, K_MSEC(100)), 0,
			  "cleanup called when refcount > 0");
	memref_unref(mem);
	zassert_ok(k_sem_take(&sem, K_MSEC(100)), "cleanup not called");
}

void memref_test_calloc_zeroed(const struct memref_backend *be)
{
	uint8_t *mem;

	mem = memref_calloc(be, 8, 12, NULL);
	zassert_not_null(mem, "memref_alloc failed");
	for (size_t i = 0; i < 8 * 12; i++) {
		zassert_equal(mem[i], 0, "mem not zeroed");
	}
	memref_unref(mem);
}

void memref_test_stress_allocs(const struct memref_backend *be)
{
	void *mem;
	const size_t alloc_size = 64;
	const size_t iterations = 100;

	for (size_t i = 0; i < iterations; i++) {
		mem = memref_alloc(be, alloc_size, NULL);
		zassert_not_null(mem, "memref_alloc failed");
		memref_unref(mem);
	}
}
```
