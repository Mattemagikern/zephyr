## lib/memref/Kconfig
```kconfig
# Copyright (c) 2025 Måns Ansgariusson <mansgariusson@gmail.com>
# SPDX-License-Identifier: Apache-2.0

menu "Memrefs: shared memory blocks allocator"

config MEMREF
	bool "Shared memory references"
	help
	  This option enables the shared memory references API, which
	  allows multiple threads to share ownership of a memory block
	  through reference counting.

if MEMREF

config MEMREF_VALIDATION
	bool "Memref validation"
	default n
	help
	  This option enables validation checks for memory references,
	  ensuring that operations on memrefs are safe and valid.
endif # SYS_MEMREF

endmenu
```

## lib/offloader/Kconfig
```kconfig
# Copyright (c) 2026 Måns Ansgariusson <mansgariusson@gmail.com>
# SPDX-License-Identifier: Apache-2.0

menuconfig OFFLOADER
	bool "Call offloader"
	depends on !LTO
	help
	  Run calls to stack-hungry APIs on dedicated threads instead of on the calling thread, so
	  that only the engine threads need a stack large enough for them.


if OFFLOADER

config OFFLOADER_PSA
	bool "Offload PSA Crypto calls"
	help
	  Allowing the psa caller(s) to use a much smaller stack, at the cost
	  of a context switch and a shared dedicated worker thread.

if OFFLOADER_PSA

config OFFLOADER_PSA_STACK_SIZE
	int "PSA offloader engine stack size"
	default 3072
	help
	  Stack size of each PSA offloader engine thread, in bytes. It must
	  accommodate the deepest offloaded PSA call.

endif # OFFLOADER_PSA

endif # OFFLOADER
```
