## lib/memref/Kconfig
```kconfig
# Copyright (c) 2026 Måns Ansgariusson <mansgariusson@gmail.com>
# SPDX-License-Identifier: Apache-2.0

menu "Memref: shared memory references"

config MEMREF
	bool "Shared memory references"
	help
	  This option enables the shared memory references API, which
	  allows multiple threads to share ownership of a memory block
	  through reference counting.

config MEMREF_DESTROY_CB
	bool "Destroy callback support"
	depends on MEMREF
	help
	  Store a per-allocation destroy callback in the memref control
	  block, invoked with the user pointer just before the block is
	  returned to its backend. Costs up to one alignment unit per
	  allocation, depending on the padding of the control block.

config MEMREF_DEBUG
	bool "Control block checks"
	depends on MEMREF
	depends on ASSERT
	help
	  Store a magic value in every memref control block and check it in
	  memref_ref() and memref_unref(). Passing a pointer that was not
	  allocated through memref, or one whose last reference was already
	  released, then fails an assertion. The check is best effort: a
	  released block may already have been reused. Costs up to one
	  alignment unit per allocation.

endmenu
```
